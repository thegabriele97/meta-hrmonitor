## conf/layer.conf
```bitbake
# We have a conf and classes directory, add to BBPATH
BBPATH .= ":${LAYERDIR}"

# We have recipes-* directories, add to BBFILES
BBFILES += "${LAYERDIR}/recipes-*/*/*.bb \
            ${LAYERDIR}/recipes-*/*/*.bbappend"

BBFILE_COLLECTIONS += "meta-hrmonitor"
BBFILE_PATTERN_meta-hrmonitor = "^${LAYERDIR}/"
BBFILE_PRIORITY_meta-hrmonitor = "6"

LAYERDEPENDS_meta-hrmonitor = "core"
LAYERSERIES_COMPAT_meta-hrmonitor = "dunfell"
```
